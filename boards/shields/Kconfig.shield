## boards/shields/Kconfig.shield
```kconfig
config SHIELD_FOXXBOARD_LEFT
  def_bool $(shields_list_contains,foxxboard_left)

config SHIELD_FOXXBOARD_RIGHT
  def_bool $(shields_list_contains,foxxboard_right)
```

## boards/shields/foxxboard/Kconfig.defconfig
```kconfig
if SHIELD_FOXXBOARD_LEFT

config ZMK_KEYBOARD_NAME
  default "Foxxboard"

config ZMK_SPLIT_ROLE_CENTRAL
  default y

endif

if SHIELD_FOXXBOARD_LEFT || SHIELD_FOXXBOARD_RIGHT

config ZMK_SPLIT
  default y

endif
```
